## config/boards/shields/temper34/Kconfig.defconfig
```kconfig
if SHIELD_TEMPER34_LEFT

# Name must be less than 16 characters long!
config ZMK_KEYBOARD_NAME
    default "Temper34"

config ZMK_SPLIT_ROLE_CENTRAL
    default y

endif

if SHIELD_TEMPER34_LEFT || SHIELD_TEMPER34_RIGHT

config ZMK_SPLIT
    default y

endif
```

## config/boards/shields/temper34/Kconfig.shield
```kconfig
config SHIELD_TEMPER34_LEFT
    def_bool $(shields_list_contains,temper34_left)

config SHIELD_TEMPER34_RIGHT
    def_bool $(shields_list_contains,temper34_right)
```
